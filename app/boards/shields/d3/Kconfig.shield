## app/boards/shields/d3/Kconfig.shield
```kconfig
# Copyright (c) 2020 Pete Johanson
# SPDX-License-Identifier: MIT

config SHIELD_d3_LEFT
	def_bool $(shields_list_contains,d3_left)

config SHIELD_d3_RIGHT
	def_bool $(shields_list_contains,d3_right)
```
